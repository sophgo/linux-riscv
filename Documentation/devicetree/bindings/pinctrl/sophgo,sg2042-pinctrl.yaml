## arch/riscv/configs/sophgo_sg2044_ap_normal_defconfig
```kconfig
# CONFIG_LOCALVERSION_AUTO is not set
CONFIG_SYSVIPC=y
CONFIG_HIGH_RES_TIMERS=y
CONFIG_BPF_SYSCALL=y
CONFIG_PREEMPT=y
CONFIG_LOG_CPU_MAX_BUF_SHIFT=13
CONFIG_CFS_BANDWIDTH=y
CONFIG_CHECKPOINT_RESTORE=y
CONFIG_SCHED_AUTOGROUP=y
CONFIG_BLK_DEV_INITRD=y
# CONFIG_RD_GZIP is not set
# CONFIG_RD_BZIP2 is not set
# CONFIG_RD_LZMA is not set
# CONFIG_RD_XZ is not set
# CONFIG_RD_LZO is not set
# CONFIG_RD_LZ4 is not set
# CONFIG_RD_ZSTD is not set
CONFIG_EXPERT=y
# CONFIG_SYSFS_SYSCALL is not set
# CONFIG_AIO is not set
# CONFIG_IO_URING is not set
CONFIG_PERF_EVENTS=y
CONFIG_KEXEC=y
CONFIG_KEXEC_FILE=y
CONFIG_ARCH_SOPHGO=y
CONFIG_ARCH_THEAD=y
# CONFIG_ERRATA_THEAD_MAE is not set
# CONFIG_ERRATA_THEAD_PMU is not set
CONFIG_SMP=y
CONFIG_NR_CPUS=4
CONFIG_HZ_300=y
# CONFIG_SUSPEND is not set
# CONFIG_STACKPROTECTOR is not set
CONFIG_MODULES=y
CONFIG_MODULE_UNLOAD=y
CONFIG_PARTITION_ADVANCED=y
CONFIG_CMDLINE_PARTITION=y
# CONFIG_SWAP is not set
CONFIG_TRANSPARENT_HUGEPAGE=y
CONFIG_NET=y
CONFIG_PACKET=y
CONFIG_PACKET_DIAG=y
CONFIG_UNIX=y
CONFIG_INET=y
CONFIG_IP_MULTICAST=y
# CONFIG_IPV6 is not set
CONFIG_NET_SCHED=y
CONFIG_PCI=y
CONFIG_PCIEPORTBUS=y
CONFIG_PCIE_DW_SOPHGO=y
CONFIG_DEVTMPFS=y
CONFIG_DEVTMPFS_MOUNT=y
CONFIG_FW_LOADER_COMPRESS=y
CONFIG_BLK_DEV_LOOP=y
CONFIG_BLK_DEV_RAM=y
CONFIG_BLK_DEV_RAM_SIZE=131072
CONFIG_NETDEVICES=y
# CONFIG_NET_VENDOR_3COM is not set
# CONFIG_NET_VENDOR_ADAPTEC is not set
# CONFIG_NET_VENDOR_AGERE is not set
# CONFIG_NET_VENDOR_ALACRITECH is not set
# CONFIG_NET_VENDOR_ALTEON is not set
# CONFIG_NET_VENDOR_AMAZON is not set
# CONFIG_NET_VENDOR_AMD is not set
# CONFIG_NET_VENDOR_AQUANTIA is not set
# CONFIG_NET_VENDOR_ARC is not set
# CONFIG_NET_VENDOR_ASIX is not set
# CONFIG_NET_VENDOR_ATHEROS is not set
# CONFIG_NET_VENDOR_BROADCOM is not set
# CONFIG_NET_VENDOR_CADENCE is not set
# CONFIG_NET_VENDOR_CAVIUM is not set
# CONFIG_NET_VENDOR_CHELSIO is not set
# CONFIG_NET_VENDOR_CISCO is not set
# CONFIG_SOPHGO_P2P is not set
# CONFIG_WLAN is not set
# CONFIG_INPUT_KEYBOARD is not set
# CONFIG_INPUT_MOUSE is not set
# CONFIG_SERIO_SERPORT is not set
CONFIG_LEGACY_PTY_COUNT=10
CONFIG_SERIAL_8250=y
# CONFIG_SERIAL_8250_DEPRECATED_OPTIONS is not set
# CONFIG_SERIAL_8250_16550A_VARIANTS is not set
CONFIG_SERIAL_8250_CONSOLE=y
CONFIG_SERIAL_8250_DW=y
CONFIG_SERIAL_OF_PLATFORM=y
CONFIG_SOPHGO_VTTY=y
CONFIG_I2C=y
CONFIG_I2C_CHARDEV=y
CONFIG_I2C_DESIGNWARE_CORE=y
CONFIG_GPIOLIB=y
CONFIG_GPIO_SYSFS=y
CONFIG_GPIO_DWAPB=y
CONFIG_MFD_SYSCON=y
# CONFIG_VIRTIO_MENU is not set
# CONFIG_VHOST_MENU is not set
# CONFIG_IOMMU_SUPPORT is not set
CONFIG_SOPHGO_AP_TPU_CARD=y
CONFIG_SOPHGO_PCIE_MODE=y
CONFIG_SOPHGO_TX_MSIX_USED=y
CONFIG_SOPHGO_TP=y
CONFIG_SOPHGO_MAP_MEMORY=y
CONFIG_SOPHGO_AP_VETH=y
CONFIG_SOPHGO_TPSYS_ERR_IRQ=y
CONFIG_SOPHGO_TPU_CARD_RAS=y
CONFIG_SOPHGO_SG2044_MSI=y
CONFIG_THEAD_C900_ACLINT_SSWI=y
CONFIG_GENERIC_PHY=y
CONFIG_TMPFS=y
CONFIG_TMPFS_POSIX_ACL=y
CONFIG_HUGETLBFS=y
CONFIG_BUG_ON_DATA_CORRUPTION=y
CONFIG_PRINTK_TIME=y
CONFIG_DEBUG_FS=y
CONFIG_SCHED_STACK_END_CHECK=y
# CONFIG_RCU_TRACE is not set
CONFIG_RCU_EQS_DEBUG=y
# CONFIG_FTRACE is not set
# CONFIG_RUNTIME_TESTING_MENU is not set
CONFIG_MEMTEST=y
```

## arch/riscv/configs/sophgo_sg2044_tp_normal_defconfig
```kconfig
CONFIG_SYSVIPC=y
# CONFIG_RD_GZIP is not set
# CONFIG_RD_BZIP2 is not set
# CONFIG_RD_LZMA is not set
# CONFIG_RD_XZ is not set
# CONFIG_RD_LZO is not set
# CONFIG_RD_LZ4 is not set
# CONFIG_RD_ZSTD is not set
CONFIG_BOOT_CONFIG=y
CONFIG_EXPERT=y
# CONFIG_AIO is not set
# CONFIG_IO_URING is not set
CONFIG_PERF_EVENTS=y
CONFIG_ARCH_SOPHGO=y
CONFIG_ARCH_THEAD=y
# CONFIG_ERRATA_THEAD_MAE is not set
# CONFIG_ERRATA_THEAD_PMU is not set
CONFIG_MODULES=y
CONFIG_MODULE_UNLOAD=y
CONFIG_DEVTMPFS=y
CONFIG_DEVTMPFS_MOUNT=y
CONFIG_BLK_DEV_RAM=y
CONFIG_BLK_DEV_RAM_SIZE=131072
# CONFIG_INPUT_KEYBOARD is not set
# CONFIG_INPUT_MOUSE is not set
CONFIG_SERIO_LIBPS2=y
CONFIG_SERIAL_8250=y
CONFIG_SERIAL_8250_CONSOLE=y
CONFIG_SERIAL_8250_DW=y
CONFIG_SERIAL_OF_PLATFORM=y
CONFIG_SOPHGO_VTTY=y
# CONFIG_HW_RANDOM is not set
# CONFIG_HWMON is not set
# CONFIG_HID_SUPPORT is not set
# CONFIG_USB_SUPPORT is not set
# CONFIG_VIRTIO_MENU is not set
# CONFIG_VHOST_MENU is not set
# CONFIG_IOMMU_SUPPORT is not set
CONFIG_SOPHGO_MAP_MEMORY=y
CONFIG_SOPHGO_MSG_CONFLICT_IRQ=y
CONFIG_CPU_IDLE_DRIVER=y
CONFIG_TMPFS=y
CONFIG_HUGETLBFS=y
CONFIG_BUG_ON_DATA_CORRUPTION=y
CONFIG_PRINTK_TIME=y
# CONFIG_FTRACE is not set
# CONFIG_RUNTIME_TESTING_MENU is not set
CONFIG_MEMTEST=y
```

## drivers/dma/sophgo/Kconfig
```kconfig
config DW_DMAC_SOPHGO
        bool "sophgo dma engine based DW DMAC"
        select DMA_ENGINE
        help
          Support the DMA engine for sophgo platform devices.
```

## drivers/gpu/drm/smifb2/Kconfig
```kconfig
# SPDX-License-Identifier: GPL-2.0-only

config DRM_SMI
        tristate "SiliconMotion SM750/SM768 DRM driver"
        depends on DRM && PCI && MMU && SND
        select DRM_VRAM_HELPER
        select DRM_KMS_HELPER
        select DRM_TTM
	select DRM_TTM_HELPER
	select SND_PCM
        help
         Say yes for SiliconMotion SM750/SM768 DRM driver.
         

config DRM_SMI_HDMI
        bool "Enable SM750 HDMI output"
        depends on DRM_SMI
        help
          Compile in support for SM750 HDMI output(Using Sil9022).


config DRM_SMI_PRIME
        bool "enable SMI PRIME"
        depends on DRM_SMI
        help
          Compile in support for PRIME(Mulit-card).
```

## drivers/mtd/spi-nor/controllers/Kconfig
```kconfig
# SPDX-License-Identifier: GPL-2.0-only
config SPI_HISI_SFC
	tristate "Hisilicon FMC SPI NOR Flash Controller(SFC)"
	depends on ARCH_HISI || COMPILE_TEST
	depends on HAS_IOMEM
	help
	  This enables support for HiSilicon FMC SPI NOR flash controller.

config SPI_NXP_SPIFI
	tristate "NXP SPI Flash Interface (SPIFI)"
	depends on OF && (ARCH_LPC18XX || COMPILE_TEST)
	depends on HAS_IOMEM
	help
	  Enable support for the NXP LPC SPI Flash Interface controller.

	  SPIFI is a specialized controller for connecting serial SPI
	  Flash. Enable this option if you have a device with a SPIFI
	  controller and want to access the Flash as a mtd device.

config SPI_SOPHGO_SPIFMC
	tristate "Sophgo SPI Flash Master Controller (SPIFMC)"
	depends on ARCH_SOPHGO || COMPILE_TEST
	depends on HAS_IOMEM
	help
	  Enable support for the Sophgo SPI Flash Master controller.

	  SPIFMC is a master controller to control serial SPI Flash.
	  Enable this option if you have a device with a SPIFMC controller
	  and want to access the Flash as a mtd device.

config SOPHGO_SPIFMC_DMMR
	bool "DMMR support for sophgo spifmc"
	depends on SPI_SOPHGO_SPIFMC
	help
	  Enable DMMR(Direct Memory Mapping Read) read for Sophgo spifmc.

	  In DMMR mode, the read address on the AHB will be directly mapped
	  to the SPI Flash, and the controller automatically reads the data
	  from the corresponding address of the SPI Flash. There is no need
	  for software to set related commands and addresses. At this time,
	  SPI Flash can be used as ROM.
```

## drivers/net/ethernet/sophgo/Kconfig
```kconfig
config SOPHGO_P2P
	tristate "Sophgon P2P Ethernet Driver over 100G eth"
	default m
	help
	  Option to select ethernet drivers for sophgo p2p network
	  on Sophgo SG2044 SoCs.

	  Sophgo P2P network interface card transmit packages
	  though 100G eth on Sophgo SG2044 SoCs.
```

## drivers/pci/controller/cadence/Kconfig
```kconfig
# SPDX-License-Identifier: GPL-2.0

menu "Cadence-based PCIe controllers"
	depends on PCI

config PCIE_CADENCE
	bool

config PCIE_CADENCE_HOST
	bool
	depends on OF
	select IRQ_DOMAIN
	select PCIE_CADENCE

config PCIE_CADENCE_EP
	bool
	depends on OF
	depends on PCI_ENDPOINT
	select PCIE_CADENCE

config PCIE_CADENCE_PLAT
	bool

config PCIE_CADENCE_PLAT_HOST
	bool "Cadence platform PCIe controller (host mode)"
	depends on OF
	select PCIE_CADENCE_HOST
	select PCIE_CADENCE_PLAT
	help
	  Say Y here if you want to support the Cadence PCIe platform controller in
	  host mode. This PCIe controller may be embedded into many different
	  vendors SoCs.

config PCIE_CADENCE_PLAT_EP
	bool "Cadence platform PCIe controller (endpoint mode)"
	depends on OF
	depends on PCI_ENDPOINT
	select PCIE_CADENCE_EP
	select PCIE_CADENCE_PLAT
	help
	  Say Y here if you want to support the Cadence PCIe platform controller in
	  endpoint mode. This PCIe controller may be embedded into many
	  different vendors SoCs.

config PCIE_SG2042
	bool "Sophgo SG2042 PCIe controller (host mode)"
	depends on ARCH_SOPHGO || COMPILE_TEST
	depends on OF
	select IRQ_MSI_LIB
	select PCI_MSI
	select PCIE_CADENCE_HOST
	help
	  Say Y here if you want to support the Sophgo SG2042 PCIe platform
	  controller in host mode. Sophgo SG2042 PCIe controller uses Cadence
	  PCIe core.

config PCIE_SG2042_HACK
	bool "Sophgo SG2042 PCIe controller (host mode) with hack"
	depends on ARCH_SOPHGO || COMPILE_TEST
	depends on OF
	depends on PCIE_SG2042
	default n
	help
	  To enable support for graphics cards and some peripherals on the 
	  Sophgo SG2042, some "hacks" are required. Say "Y" to enable it.

config PCI_J721E
	bool

config PCI_J721E_HOST
	bool "TI J721E PCIe controller (host mode)"
	depends on ARCH_K3 || COMPILE_TEST
	depends on OF
	select PCIE_CADENCE_HOST
	select PCI_J721E
	help
	  Say Y here if you want to support the TI J721E PCIe platform
	  controller in host mode. TI J721E PCIe controller uses Cadence PCIe
	  core.

config PCI_J721E_EP
	bool "TI J721E PCIe controller (endpoint mode)"
	depends on ARCH_K3 || COMPILE_TEST
	depends on OF
	depends on PCI_ENDPOINT
	select PCIE_CADENCE_EP
	select PCI_J721E
	help
	  Say Y here if you want to support the TI J721E PCIe platform
	  controller in endpoint mode. TI J721E PCIe controller uses Cadence PCIe
	  core.

endmenu
```

## drivers/pinctrl/sophgo/Kconfig
```kconfig
# SPDX-License-Identifier: GPL-2.0
#
# Sophgo Pin control drivers
#
config PINCTRL_SG2044
	bool "pin control support for Sophgo"
	select PINMUX
	select PINCTRL_GROUPS
	select GENERIC_PINCONF
	select GENERIC_PINCTRL_GROUPS
	help
	  This selects GPIO and pinctrl driver for Sophgo
	  platforms.
```

## drivers/soc/sophgo/Kconfig
```kconfig
# SPDX-License-Identifier: GPL-2.0-only
menu "Sophgo Soc specific Drivers"

source "drivers/soc/sophgo/ap_sgcard/Kconfig"
source "drivers/soc/sophgo/pcie_ep/Kconfig"
source "drivers/soc/sophgo/tp_driver/Kconfig"
source "drivers/soc/sophgo/map_memory/Kconfig"
source "drivers/soc/sophgo/veth/Kconfig"
source "drivers/soc/sophgo/tpsys_err_intr/Kconfig"
source "drivers/soc/sophgo/msg_intr/Kconfig"
source "drivers/soc/sophgo/ras/Kconfig"

endmenu
```

## drivers/soc/sophgo/ap_sgcard/Kconfig
```kconfig
# SPDX-License-Identifier: GPL-2.0

config SOPHGO_AP_TPU_CARD
	bool "sophgo soc support tpu card"
```

## drivers/soc/sophgo/cpu_idle/Kconfig
```kconfig
config CPU_IDLE_DRIVER
    bool "Cpu Idle Driver (Built-in)"
    default no
    help
      This is a cpu idle interrupt driver.
      Trigger a wake-up interrupt to bring the CPU out of WFI state
```

## drivers/soc/sophgo/map_memory/Kconfig
```kconfig
# SPDX-License-Identifier: GPL-2.0

config SOPHGO_MAP_MEMORY
	bool "sophgo soc map memory"
```

## drivers/soc/sophgo/msg_intr/Kconfig
```kconfig
# SPDX-License-Identifier: GPL-2.0

config SOPHGO_MSG_CONFLICT_IRQ
	bool "sophgo msg conflict err irq for tp"
```

## drivers/soc/sophgo/pcie_ep/Kconfig
```kconfig
# SPDX-License-Identifier: GPL-2.0

config SOPHGO_PCIE_MODE
	bool "sophgo soc as pcie ep"

config SOPHGO_TX_MSIX_USED
	bool "EP report interrupt to host by using msi-x mode"
```

## drivers/soc/sophgo/ras/Kconfig
```kconfig
# SPDX-License-Identifier: GPL-2.0

config SOPHGO_TPU_CARD_RAS
	bool "sophgo pcie card support ras"
```

## drivers/soc/sophgo/tp_driver/Kconfig
```kconfig
# SPDX-License-Identifier: GPL-2.0

config SOPHGO_TP
	bool "sophgo soc as pcie ep"
```

## drivers/soc/sophgo/tpsys_err_intr/Kconfig
```kconfig
# SPDX-License-Identifier: GPL-2.0

config SOPHGO_TPSYS_ERR_IRQ
	bool "sophgo tpsys err irq for ap"
```

## drivers/soc/sophgo/veth/Kconfig
```kconfig
# SPDX-License-Identifier: GPL-2.0

config SOPHGO_AP_VETH
	bool "sophgo host ap veth"
```
