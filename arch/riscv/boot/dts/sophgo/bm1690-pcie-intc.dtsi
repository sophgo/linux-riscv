#include <dt-bindings/interrupt-controller/irq.h>

/ {
	intc1: pcie_intc@6E10000000 {
		compatible = "sophgo,pcie-intc";
		reg = <0x0  0xFEE00060 0x0 0x8>,
		      <0x6E 0x10000000 0x0 0x256>;
		reg-names = "set", "clr";
		reg-bitwidth = <32>;
		interrupt-controller;
		interrupt-cells = <0x2>; // only applies to child node
		for-msi;

		interrupt-parent = <&intc>;
		interrupts = <352 IRQ_TYPE_LEVEL_HIGH>, <353 IRQ_TYPE_LEVEL_HIGH>,
			     <354 IRQ_TYPE_LEVEL_HIGH>, <355 IRQ_TYPE_LEVEL_HIGH>,
			     <356 IRQ_TYPE_LEVEL_HIGH>, <357 IRQ_TYPE_LEVEL_HIGH>,
			     <358 IRQ_TYPE_LEVEL_HIGH>, <359 IRQ_TYPE_LEVEL_HIGH>,
			     <360 IRQ_TYPE_LEVEL_HIGH>, <361 IRQ_TYPE_LEVEL_HIGH>,
			     <362 IRQ_TYPE_LEVEL_HIGH>, <363 IRQ_TYPE_LEVEL_HIGH>,
			     <364 IRQ_TYPE_LEVEL_HIGH>, <365 IRQ_TYPE_LEVEL_HIGH>,
			     <366 IRQ_TYPE_LEVEL_HIGH>, <367 IRQ_TYPE_LEVEL_HIGH>,
			     <368 IRQ_TYPE_LEVEL_HIGH>, <369 IRQ_TYPE_LEVEL_HIGH>,
			     <370 IRQ_TYPE_LEVEL_HIGH>, <371 IRQ_TYPE_LEVEL_HIGH>,
			     <372 IRQ_TYPE_LEVEL_HIGH>, <373 IRQ_TYPE_LEVEL_HIGH>,
			     <374 IRQ_TYPE_LEVEL_HIGH>, <375 IRQ_TYPE_LEVEL_HIGH>,
			     <376 IRQ_TYPE_LEVEL_HIGH>, <377 IRQ_TYPE_LEVEL_HIGH>,
			     <378 IRQ_TYPE_LEVEL_HIGH>, <379 IRQ_TYPE_LEVEL_HIGH>,
			     <380 IRQ_TYPE_LEVEL_HIGH>, <381 IRQ_TYPE_LEVEL_HIGH>,
			     <382 IRQ_TYPE_LEVEL_HIGH>, <383 IRQ_TYPE_LEVEL_HIGH>,
			     <384 IRQ_TYPE_LEVEL_HIGH>, <385 IRQ_TYPE_LEVEL_HIGH>,
			     <386 IRQ_TYPE_LEVEL_HIGH>, <387 IRQ_TYPE_LEVEL_HIGH>,
			     <388 IRQ_TYPE_LEVEL_HIGH>, <389 IRQ_TYPE_LEVEL_HIGH>,
			     <390 IRQ_TYPE_LEVEL_HIGH>, <391 IRQ_TYPE_LEVEL_HIGH>,
			     <392 IRQ_TYPE_LEVEL_HIGH>, <393 IRQ_TYPE_LEVEL_HIGH>,
			     <394 IRQ_TYPE_LEVEL_HIGH>, <395 IRQ_TYPE_LEVEL_HIGH>,
			     <396 IRQ_TYPE_LEVEL_HIGH>, <397 IRQ_TYPE_LEVEL_HIGH>,
			     <398 IRQ_TYPE_LEVEL_HIGH>, <399 IRQ_TYPE_LEVEL_HIGH>,
			     <400 IRQ_TYPE_LEVEL_HIGH>, <401 IRQ_TYPE_LEVEL_HIGH>,
			     <402 IRQ_TYPE_LEVEL_HIGH>, <403 IRQ_TYPE_LEVEL_HIGH>,
			     <404 IRQ_TYPE_LEVEL_HIGH>, <405 IRQ_TYPE_LEVEL_HIGH>,
			     <406 IRQ_TYPE_LEVEL_HIGH>, <407 IRQ_TYPE_LEVEL_HIGH>,
			     <408 IRQ_TYPE_LEVEL_HIGH>, <409 IRQ_TYPE_LEVEL_HIGH>,
			     <410 IRQ_TYPE_LEVEL_HIGH>, <411 IRQ_TYPE_LEVEL_HIGH>,
			     <412 IRQ_TYPE_LEVEL_HIGH>, <413 IRQ_TYPE_LEVEL_HIGH>,
			     <414 IRQ_TYPE_LEVEL_HIGH>, <415 IRQ_TYPE_LEVEL_HIGH>;
		interrupt-names = "msi0",  "msi1",  "msi2",  "msi3",
				  "msi4",  "msi5",  "msi6",  "msi7",
				  "msi8",  "msi9",  "msi10", "msi11",
				  "msi12", "msi13", "msi14", "msi15",
				  "msi16", "msi17", "msi18", "msi19",
				  "msi20", "msi21", "msi22", "msi23",
				  "msi24", "msi25", "msi26", "msi27",
				  "msi28", "msi29", "msi30", "msi31",
				  "msi32", "msi33", "msi34", "msi35",
				  "msi36", "msi37", "msi38", "msi39",
				  "msi40", "msi41", "msi42", "msi43",
				  "msi44", "msi45", "msi46", "msi47",
				  "msi48", "msi49", "msi50", "msi51",
				  "msi52", "msi53", "msi54", "msi55",
				  "msi56", "msi57", "msi58", "msi59",
				  "msi60", "msi61", "msi62", "msi63";

	};
};
