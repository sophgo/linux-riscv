// SPDX-License-Identifier: (GPL-2.0 OR MIT)
/*
 * Copyright (C) 2022 Sophgo Technology Inc. All rights reserved.
 */

/ {
	soc {
		sophgo_card@0 {
			compatible = "sophgo,sophgo-card";
			reg = <0x1e 0xf8000000 0x00000000 0x01400000>,
				<0x70 0x50000000 0x00000000 0x00001000>,
				<0x70 0x101ff000 0x00000000 0x00001000>;
			reg-names = "share-memory", "top-reg", "config_file";

			host-channel-num = <1>;
			tpu-channel-num = <8>;
			media-channel-num = <0>;
			tx-channel = <0x0 0x2 0x4 0x6 0x8 0xa 0xc 0xe 0x10>;
			rx-channel = <0x1 0x3 0x5 0x7 0x9 0xb 0xd 0xf 0x11>;
			channel-size = <0x100000>;
			share-memory-type = <1>;

			interrupt-parent = <&intc>;
			interrupts = <352 IRQ_TYPE_EDGE_RISING>,
					<353 IRQ_TYPE_EDGE_RISING>,
					<354 IRQ_TYPE_EDGE_RISING>,
					<355 IRQ_TYPE_EDGE_RISING>,
					<356 IRQ_TYPE_EDGE_RISING>,
					<357 IRQ_TYPE_EDGE_RISING>,
					<358 IRQ_TYPE_EDGE_RISING>,
					<359 IRQ_TYPE_EDGE_RISING>,
					<360 IRQ_TYPE_EDGE_RISING>;
			clr-irq = <0x6E 0x10000000 0x00000000 0x00000000>,
					<0x6E 0x10000004 0x00000000 0x00000000>,
					<0x6E 0x10000008 0x00000000 0x00000000>,
					<0x6E 0x1000000c 0x00000000 0x00000000>,
					<0x6E 0x10000010 0x00000000 0x00000000>,
					<0x6E 0x10000014 0x00000000 0x00000000>,
					<0x6E 0x10000018 0x00000000 0x00000000>,
					<0x6E 0x1000001c 0x00000000 0x00000000>,
					<0x6E 0x10000020 0x00000000 0x00000000>;
			virtual-msi = <0x6d 0x500007fc 0x00000000 0x00000001>,
					<0x69 0x0cd00000 0x00000000 0x00000001>,
					<0x69 0x1cd00000 0x00000000 0x00000001>,
					<0x69 0x2cd00000 0x00000000 0x00000001>,
					<0x69 0x3cd00000 0x00000000 0x00000001>,
					<0x69 0x4cd00000 0x00000000 0x00000001>,
					<0x69 0x5cd00000 0x00000000 0x00000001>,
					<0x69 0x6cd00000 0x00000000 0x00000001>,
					<0x69 0x7cd00000 0x00000000 0x00000001>;
		};
	};
};
