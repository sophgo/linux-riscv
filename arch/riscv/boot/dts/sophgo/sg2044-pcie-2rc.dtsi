#include <dt-bindings/interrupt-controller/irq.h>

/ {
#if 1
	pcie@6c00000000 {
		compatible = "sophgo,sg2044-pcie-host";
		device_type = "pci";
		#address-cells = <3>;
		#size-cells = <2>;

		bus-range = <0x00 0x7f>;
		linux,pci-domain = <0>;
		cdns,max-outbound-regions = <16>;
		cdns,no-bar-match-nbits = <48>;
		//vendor-id = /bits/ 16 <0x1E30>;
		//device-id = /bits/ 16 <0x2042>;
		pcie-id = /bits/ 16 <0x1>;
		link-id = /bits/ 16 <0x0>;
		interrupt-parent = <&intc1>;
		reg = <0x6c 0x00400000  0x0 0x00001000>,
		      <0x6c 0x00700000  0x0 0x00004000>,
		      <0x40 0x00000000  0x0 0x00001000>;
		reg-names = "dbi", "atu", "config";
		dma-coherent;
		// IO, check IO_SPACE_LIMIT
		// 32bit prefetchable memory
		// 32bit non-prefetchable memory
		// 64bit prefetchable memory
		// 64bit non-prefetchable memory
		ranges = <0x01000000 0x0  0x00000000  0x40 0x10000000  0x0 0x00400000>,
			 <0x42000000 0x0  0x00000000  0x0  0x00000000  0x0 0x20000000>,
			 <0x02000000 0x0  0x20000000  0x0  0x20000000  0x0 0x20000000>,
			 <0x43000000 0x42 0x00000000  0x42 0x00000000  0x2 0x00000000>,
			 <0x03000000 0x41 0x00000000  0x41 0x00000000  0x1 0x00000000>;
		dma-ranges = <0x03000000 0x0 0x0 0x0 0x0 0x40 0x0>,
			     <0x43000000 0x40 0x0 0x40 0x0 0x40 0x0>;

		status = "okay";
	};
#else
	pcie@6c08800000 {
		compatible = "sophgo,sg2044-pcie-host";
		device_type = "pci";
		#address-cells = <3>;
		#size-cells = <2>;

		bus-range = <0x00 0x7f>;
		linux,pci-domain = <0>;
		cdns,max-outbound-regions = <16>;
		cdns,no-bar-match-nbits = <48>;
		//vendor-id = /bits/ 16 <0x1E30>;
		//device-id = /bits/ 16 <0x2042>;
		pcie-id = /bits/ 16 <0x1>;
		link-id = /bits/ 16 <0x0>;
		interrupt-parent = <&intc1>;
		reg = <0x6c 0x08800000  0x0 0x00001000>,
		      <0x6c 0x08b00000  0x0 0x00004000>,
		      <0x64 0x00000000  0x0 0x00001000>;
		reg-names = "dbi", "atu", "config";
		dma-coherent;
		// IO, check IO_SPACE_LIMIT
		// 32bit prefetchable memory
		// 32bit non-prefetchable memory
		// 64bit prefetchable memory
		// 64bit non-prefetchable memory
		ranges = <0x01000000 0x0  0x00000000  0x64 0x10000000  0x0 0x00400000>,
			 <0x42000000 0x0  0x00000000  0x0  0x00000000  0x0 0x40000000>,
			 <0x02000000 0x0  0x40000000  0x0  0x40000000  0x0 0x30000000>,
			 <0x43000000 0x66 0x00000000  0x66 0x00000000  0x2 0x00000000>,
			 <0x03000000 0x65 0x00000000  0x65 0x00000000  0x1 0x00000000>;
		dma-ranges = <0x03000000 0x0 0x0 0x0 0x0 0x40 0x0>,
			     <0x43000000 0x40 0x0 0x40 0x0 0x40 0x0>;

		status = "okay";
	};
#endif
};
