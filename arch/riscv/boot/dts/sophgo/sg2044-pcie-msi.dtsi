#include <dt-bindings/interrupt-controller/irq.h>

/ {
	soc {
		msi: msi-controller@6D50000000 {
			compatible = "sophgo,sg2044-msi";
			reg = <0x0  0x7EE00000 0x0 0x40>,
			      <0x6D 0x50000000 0x0 0x800>;
			reg-names = "set", "clr";
			reg-bitwidth = <32>;
			msi-controller;
			sophgo,msi-num-vecs = <504>;
			interrupt-parent = <&intc>;
			interrupts = <352 IRQ_TYPE_LEVEL_HIGH>, <353 IRQ_TYPE_LEVEL_HIGH>,
				     <354 IRQ_TYPE_LEVEL_HIGH>, <355 IRQ_TYPE_LEVEL_HIGH>,
				     <356 IRQ_TYPE_LEVEL_HIGH>, <357 IRQ_TYPE_LEVEL_HIGH>,
				     <358 IRQ_TYPE_LEVEL_HIGH>, <359 IRQ_TYPE_LEVEL_HIGH>,
				     <360 IRQ_TYPE_LEVEL_HIGH>, <361 IRQ_TYPE_LEVEL_HIGH>,
				     <362 IRQ_TYPE_LEVEL_HIGH>, <363 IRQ_TYPE_LEVEL_HIGH>,
				     <364 IRQ_TYPE_LEVEL_HIGH>, <365 IRQ_TYPE_LEVEL_HIGH>,
				     <366 IRQ_TYPE_LEVEL_HIGH>, <367 IRQ_TYPE_LEVEL_HIGH>,
				     <368 IRQ_TYPE_LEVEL_HIGH>, <369 IRQ_TYPE_LEVEL_HIGH>,
				     <370 IRQ_TYPE_LEVEL_HIGH>, <371 IRQ_TYPE_LEVEL_HIGH>,
				     <372 IRQ_TYPE_LEVEL_HIGH>, <373 IRQ_TYPE_LEVEL_HIGH>,
				     <374 IRQ_TYPE_LEVEL_HIGH>, <375 IRQ_TYPE_LEVEL_HIGH>,
				     <376 IRQ_TYPE_LEVEL_HIGH>, <377 IRQ_TYPE_LEVEL_HIGH>,
				     <378 IRQ_TYPE_LEVEL_HIGH>, <379 IRQ_TYPE_LEVEL_HIGH>,
				     <380 IRQ_TYPE_LEVEL_HIGH>, <381 IRQ_TYPE_LEVEL_HIGH>,
				     <382 IRQ_TYPE_LEVEL_HIGH>, <383 IRQ_TYPE_LEVEL_HIGH>,
				     <384 IRQ_TYPE_LEVEL_HIGH>, <385 IRQ_TYPE_LEVEL_HIGH>,
				     <386 IRQ_TYPE_LEVEL_HIGH>, <387 IRQ_TYPE_LEVEL_HIGH>,
				     <388 IRQ_TYPE_LEVEL_HIGH>, <389 IRQ_TYPE_LEVEL_HIGH>,
				     <390 IRQ_TYPE_LEVEL_HIGH>, <391 IRQ_TYPE_LEVEL_HIGH>,
				     <392 IRQ_TYPE_LEVEL_HIGH>, <393 IRQ_TYPE_LEVEL_HIGH>,
				     <394 IRQ_TYPE_LEVEL_HIGH>, <395 IRQ_TYPE_LEVEL_HIGH>,
				     <396 IRQ_TYPE_LEVEL_HIGH>, <397 IRQ_TYPE_LEVEL_HIGH>,
				     <398 IRQ_TYPE_LEVEL_HIGH>, <399 IRQ_TYPE_LEVEL_HIGH>,
				     <400 IRQ_TYPE_LEVEL_HIGH>, <401 IRQ_TYPE_LEVEL_HIGH>,
				     <402 IRQ_TYPE_LEVEL_HIGH>, <403 IRQ_TYPE_LEVEL_HIGH>,
				     <404 IRQ_TYPE_LEVEL_HIGH>, <405 IRQ_TYPE_LEVEL_HIGH>,
				     <406 IRQ_TYPE_LEVEL_HIGH>, <407 IRQ_TYPE_LEVEL_HIGH>,
				     <408 IRQ_TYPE_LEVEL_HIGH>, <409 IRQ_TYPE_LEVEL_HIGH>,
				     <410 IRQ_TYPE_LEVEL_HIGH>, <411 IRQ_TYPE_LEVEL_HIGH>,
				     <412 IRQ_TYPE_LEVEL_HIGH>, <413 IRQ_TYPE_LEVEL_HIGH>,
				     <414 IRQ_TYPE_LEVEL_HIGH>, <415 IRQ_TYPE_LEVEL_HIGH>,
				     <416 IRQ_TYPE_LEVEL_HIGH>, <417 IRQ_TYPE_LEVEL_HIGH>,
				     <418 IRQ_TYPE_LEVEL_HIGH>, <419 IRQ_TYPE_LEVEL_HIGH>,
				     <420 IRQ_TYPE_LEVEL_HIGH>, <421 IRQ_TYPE_LEVEL_HIGH>,
				     <422 IRQ_TYPE_LEVEL_HIGH>, <423 IRQ_TYPE_LEVEL_HIGH>,
				     <424 IRQ_TYPE_LEVEL_HIGH>, <425 IRQ_TYPE_LEVEL_HIGH>,
				     <426 IRQ_TYPE_LEVEL_HIGH>, <427 IRQ_TYPE_LEVEL_HIGH>,
				     <428 IRQ_TYPE_LEVEL_HIGH>, <429 IRQ_TYPE_LEVEL_HIGH>,
				     <430 IRQ_TYPE_LEVEL_HIGH>, <431 IRQ_TYPE_LEVEL_HIGH>,
				     <432 IRQ_TYPE_LEVEL_HIGH>, <433 IRQ_TYPE_LEVEL_HIGH>,
				     <434 IRQ_TYPE_LEVEL_HIGH>, <435 IRQ_TYPE_LEVEL_HIGH>,
				     <436 IRQ_TYPE_LEVEL_HIGH>, <437 IRQ_TYPE_LEVEL_HIGH>,
				     <438 IRQ_TYPE_LEVEL_HIGH>, <439 IRQ_TYPE_LEVEL_HIGH>,
				     <440 IRQ_TYPE_LEVEL_HIGH>, <441 IRQ_TYPE_LEVEL_HIGH>,
				     <442 IRQ_TYPE_LEVEL_HIGH>, <443 IRQ_TYPE_LEVEL_HIGH>,
				     <444 IRQ_TYPE_LEVEL_HIGH>, <445 IRQ_TYPE_LEVEL_HIGH>,
				     <446 IRQ_TYPE_LEVEL_HIGH>, <447 IRQ_TYPE_LEVEL_HIGH>,
				     <448 IRQ_TYPE_LEVEL_HIGH>, <449 IRQ_TYPE_LEVEL_HIGH>,
				     <450 IRQ_TYPE_LEVEL_HIGH>, <451 IRQ_TYPE_LEVEL_HIGH>,
				     <452 IRQ_TYPE_LEVEL_HIGH>, <453 IRQ_TYPE_LEVEL_HIGH>,
				     <454 IRQ_TYPE_LEVEL_HIGH>, <455 IRQ_TYPE_LEVEL_HIGH>,
				     <456 IRQ_TYPE_LEVEL_HIGH>, <457 IRQ_TYPE_LEVEL_HIGH>,
				     <458 IRQ_TYPE_LEVEL_HIGH>, <459 IRQ_TYPE_LEVEL_HIGH>,
				     <460 IRQ_TYPE_LEVEL_HIGH>, <461 IRQ_TYPE_LEVEL_HIGH>,
				     <462 IRQ_TYPE_LEVEL_HIGH>, <463 IRQ_TYPE_LEVEL_HIGH>,
				     <464 IRQ_TYPE_LEVEL_HIGH>, <465 IRQ_TYPE_LEVEL_HIGH>,
				     <466 IRQ_TYPE_LEVEL_HIGH>, <467 IRQ_TYPE_LEVEL_HIGH>,
				     <468 IRQ_TYPE_LEVEL_HIGH>, <469 IRQ_TYPE_LEVEL_HIGH>,
				     <470 IRQ_TYPE_LEVEL_HIGH>, <471 IRQ_TYPE_LEVEL_HIGH>,
				     <472 IRQ_TYPE_LEVEL_HIGH>, <473 IRQ_TYPE_LEVEL_HIGH>,
				     <474 IRQ_TYPE_LEVEL_HIGH>, <475 IRQ_TYPE_LEVEL_HIGH>,
				     <476 IRQ_TYPE_LEVEL_HIGH>, <477 IRQ_TYPE_LEVEL_HIGH>,
				     <478 IRQ_TYPE_LEVEL_HIGH>, <479 IRQ_TYPE_LEVEL_HIGH>,
				     <480 IRQ_TYPE_LEVEL_HIGH>, <481 IRQ_TYPE_LEVEL_HIGH>,
				     <482 IRQ_TYPE_LEVEL_HIGH>, <483 IRQ_TYPE_LEVEL_HIGH>,
				     <484 IRQ_TYPE_LEVEL_HIGH>, <485 IRQ_TYPE_LEVEL_HIGH>,
				     <486 IRQ_TYPE_LEVEL_HIGH>, <487 IRQ_TYPE_LEVEL_HIGH>,
				     <488 IRQ_TYPE_LEVEL_HIGH>, <489 IRQ_TYPE_LEVEL_HIGH>,
				     <490 IRQ_TYPE_LEVEL_HIGH>, <491 IRQ_TYPE_LEVEL_HIGH>,
				     <492 IRQ_TYPE_LEVEL_HIGH>, <493 IRQ_TYPE_LEVEL_HIGH>,
				     <494 IRQ_TYPE_LEVEL_HIGH>, <495 IRQ_TYPE_LEVEL_HIGH>,
				     <496 IRQ_TYPE_LEVEL_HIGH>, <497 IRQ_TYPE_LEVEL_HIGH>,
				     <498 IRQ_TYPE_LEVEL_HIGH>, <499 IRQ_TYPE_LEVEL_HIGH>,
				     <500 IRQ_TYPE_LEVEL_HIGH>, <501 IRQ_TYPE_LEVEL_HIGH>,
				     <502 IRQ_TYPE_LEVEL_HIGH>, <503 IRQ_TYPE_LEVEL_HIGH>,
				     <504 IRQ_TYPE_LEVEL_HIGH>, <505 IRQ_TYPE_LEVEL_HIGH>,
				     <506 IRQ_TYPE_LEVEL_HIGH>, <507 IRQ_TYPE_LEVEL_HIGH>,
				     <508 IRQ_TYPE_LEVEL_HIGH>, <509 IRQ_TYPE_LEVEL_HIGH>,
				     <510 IRQ_TYPE_LEVEL_HIGH>, <511 IRQ_TYPE_LEVEL_HIGH>,
				     <512 IRQ_TYPE_LEVEL_HIGH>, <513 IRQ_TYPE_LEVEL_HIGH>,
				     <514 IRQ_TYPE_LEVEL_HIGH>, <515 IRQ_TYPE_LEVEL_HIGH>,
				     <516 IRQ_TYPE_LEVEL_HIGH>, <517 IRQ_TYPE_LEVEL_HIGH>,
				     <518 IRQ_TYPE_LEVEL_HIGH>, <519 IRQ_TYPE_LEVEL_HIGH>,
				     <520 IRQ_TYPE_LEVEL_HIGH>, <521 IRQ_TYPE_LEVEL_HIGH>,
				     <522 IRQ_TYPE_LEVEL_HIGH>, <523 IRQ_TYPE_LEVEL_HIGH>,
				     <524 IRQ_TYPE_LEVEL_HIGH>, <525 IRQ_TYPE_LEVEL_HIGH>,
				     <526 IRQ_TYPE_LEVEL_HIGH>, <527 IRQ_TYPE_LEVEL_HIGH>,
				     <528 IRQ_TYPE_LEVEL_HIGH>, <529 IRQ_TYPE_LEVEL_HIGH>,
				     <530 IRQ_TYPE_LEVEL_HIGH>, <531 IRQ_TYPE_LEVEL_HIGH>,
				     <532 IRQ_TYPE_LEVEL_HIGH>, <533 IRQ_TYPE_LEVEL_HIGH>,
				     <534 IRQ_TYPE_LEVEL_HIGH>, <535 IRQ_TYPE_LEVEL_HIGH>,
				     <536 IRQ_TYPE_LEVEL_HIGH>, <537 IRQ_TYPE_LEVEL_HIGH>,
				     <538 IRQ_TYPE_LEVEL_HIGH>, <539 IRQ_TYPE_LEVEL_HIGH>,
				     <540 IRQ_TYPE_LEVEL_HIGH>, <541 IRQ_TYPE_LEVEL_HIGH>,
				     <542 IRQ_TYPE_LEVEL_HIGH>, <543 IRQ_TYPE_LEVEL_HIGH>,
				     <544 IRQ_TYPE_LEVEL_HIGH>, <545 IRQ_TYPE_LEVEL_HIGH>,
				     <546 IRQ_TYPE_LEVEL_HIGH>, <547 IRQ_TYPE_LEVEL_HIGH>,
				     <548 IRQ_TYPE_LEVEL_HIGH>, <549 IRQ_TYPE_LEVEL_HIGH>,
				     <550 IRQ_TYPE_LEVEL_HIGH>, <551 IRQ_TYPE_LEVEL_HIGH>,
				     <552 IRQ_TYPE_LEVEL_HIGH>, <553 IRQ_TYPE_LEVEL_HIGH>,
				     <554 IRQ_TYPE_LEVEL_HIGH>, <555 IRQ_TYPE_LEVEL_HIGH>,
				     <556 IRQ_TYPE_LEVEL_HIGH>, <557 IRQ_TYPE_LEVEL_HIGH>,
				     <558 IRQ_TYPE_LEVEL_HIGH>, <559 IRQ_TYPE_LEVEL_HIGH>,
				     <560 IRQ_TYPE_LEVEL_HIGH>, <561 IRQ_TYPE_LEVEL_HIGH>,
				     <562 IRQ_TYPE_LEVEL_HIGH>, <563 IRQ_TYPE_LEVEL_HIGH>,
				     <564 IRQ_TYPE_LEVEL_HIGH>, <565 IRQ_TYPE_LEVEL_HIGH>,
				     <566 IRQ_TYPE_LEVEL_HIGH>, <567 IRQ_TYPE_LEVEL_HIGH>,
				     <568 IRQ_TYPE_LEVEL_HIGH>, <569 IRQ_TYPE_LEVEL_HIGH>,
				     <570 IRQ_TYPE_LEVEL_HIGH>, <571 IRQ_TYPE_LEVEL_HIGH>,
				     <572 IRQ_TYPE_LEVEL_HIGH>, <573 IRQ_TYPE_LEVEL_HIGH>,
				     <574 IRQ_TYPE_LEVEL_HIGH>, <575 IRQ_TYPE_LEVEL_HIGH>,
				     <576 IRQ_TYPE_LEVEL_HIGH>, <577 IRQ_TYPE_LEVEL_HIGH>,
				     <578 IRQ_TYPE_LEVEL_HIGH>, <579 IRQ_TYPE_LEVEL_HIGH>,
				     <580 IRQ_TYPE_LEVEL_HIGH>, <581 IRQ_TYPE_LEVEL_HIGH>,
				     <582 IRQ_TYPE_LEVEL_HIGH>, <583 IRQ_TYPE_LEVEL_HIGH>,
				     <584 IRQ_TYPE_LEVEL_HIGH>, <585 IRQ_TYPE_LEVEL_HIGH>,
				     <586 IRQ_TYPE_LEVEL_HIGH>, <587 IRQ_TYPE_LEVEL_HIGH>,
				     <588 IRQ_TYPE_LEVEL_HIGH>, <589 IRQ_TYPE_LEVEL_HIGH>,
				     <590 IRQ_TYPE_LEVEL_HIGH>, <591 IRQ_TYPE_LEVEL_HIGH>,
				     <592 IRQ_TYPE_LEVEL_HIGH>, <593 IRQ_TYPE_LEVEL_HIGH>,
				     <594 IRQ_TYPE_LEVEL_HIGH>, <595 IRQ_TYPE_LEVEL_HIGH>,
				     <596 IRQ_TYPE_LEVEL_HIGH>, <597 IRQ_TYPE_LEVEL_HIGH>,
				     <598 IRQ_TYPE_LEVEL_HIGH>, <599 IRQ_TYPE_LEVEL_HIGH>,
				     <600 IRQ_TYPE_LEVEL_HIGH>, <601 IRQ_TYPE_LEVEL_HIGH>,
				     <602 IRQ_TYPE_LEVEL_HIGH>, <603 IRQ_TYPE_LEVEL_HIGH>,
				     <604 IRQ_TYPE_LEVEL_HIGH>, <605 IRQ_TYPE_LEVEL_HIGH>,
				     <606 IRQ_TYPE_LEVEL_HIGH>, <607 IRQ_TYPE_LEVEL_HIGH>,
				     <608 IRQ_TYPE_LEVEL_HIGH>, <609 IRQ_TYPE_LEVEL_HIGH>,
				     <610 IRQ_TYPE_LEVEL_HIGH>, <611 IRQ_TYPE_LEVEL_HIGH>,
				     <612 IRQ_TYPE_LEVEL_HIGH>, <613 IRQ_TYPE_LEVEL_HIGH>,
				     <614 IRQ_TYPE_LEVEL_HIGH>, <615 IRQ_TYPE_LEVEL_HIGH>,
				     <616 IRQ_TYPE_LEVEL_HIGH>, <617 IRQ_TYPE_LEVEL_HIGH>,
				     <618 IRQ_TYPE_LEVEL_HIGH>, <619 IRQ_TYPE_LEVEL_HIGH>,
				     <620 IRQ_TYPE_LEVEL_HIGH>, <621 IRQ_TYPE_LEVEL_HIGH>,
				     <622 IRQ_TYPE_LEVEL_HIGH>, <623 IRQ_TYPE_LEVEL_HIGH>,
				     <624 IRQ_TYPE_LEVEL_HIGH>, <625 IRQ_TYPE_LEVEL_HIGH>,
				     <626 IRQ_TYPE_LEVEL_HIGH>, <627 IRQ_TYPE_LEVEL_HIGH>,
				     <628 IRQ_TYPE_LEVEL_HIGH>, <629 IRQ_TYPE_LEVEL_HIGH>,
				     <630 IRQ_TYPE_LEVEL_HIGH>, <631 IRQ_TYPE_LEVEL_HIGH>,
				     <632 IRQ_TYPE_LEVEL_HIGH>, <633 IRQ_TYPE_LEVEL_HIGH>,
				     <634 IRQ_TYPE_LEVEL_HIGH>, <635 IRQ_TYPE_LEVEL_HIGH>,
				     <636 IRQ_TYPE_LEVEL_HIGH>, <637 IRQ_TYPE_LEVEL_HIGH>,
				     <638 IRQ_TYPE_LEVEL_HIGH>, <639 IRQ_TYPE_LEVEL_HIGH>,
				     <640 IRQ_TYPE_LEVEL_HIGH>, <641 IRQ_TYPE_LEVEL_HIGH>,
				     <642 IRQ_TYPE_LEVEL_HIGH>, <643 IRQ_TYPE_LEVEL_HIGH>,
				     <644 IRQ_TYPE_LEVEL_HIGH>, <645 IRQ_TYPE_LEVEL_HIGH>,
				     <646 IRQ_TYPE_LEVEL_HIGH>, <647 IRQ_TYPE_LEVEL_HIGH>,
				     <648 IRQ_TYPE_LEVEL_HIGH>, <649 IRQ_TYPE_LEVEL_HIGH>,
				     <650 IRQ_TYPE_LEVEL_HIGH>, <651 IRQ_TYPE_LEVEL_HIGH>,
				     <652 IRQ_TYPE_LEVEL_HIGH>, <653 IRQ_TYPE_LEVEL_HIGH>,
				     <654 IRQ_TYPE_LEVEL_HIGH>, <655 IRQ_TYPE_LEVEL_HIGH>,
				     <656 IRQ_TYPE_LEVEL_HIGH>, <657 IRQ_TYPE_LEVEL_HIGH>,
				     <658 IRQ_TYPE_LEVEL_HIGH>, <659 IRQ_TYPE_LEVEL_HIGH>,
				     <660 IRQ_TYPE_LEVEL_HIGH>, <661 IRQ_TYPE_LEVEL_HIGH>,
				     <662 IRQ_TYPE_LEVEL_HIGH>, <663 IRQ_TYPE_LEVEL_HIGH>,
				     <664 IRQ_TYPE_LEVEL_HIGH>, <665 IRQ_TYPE_LEVEL_HIGH>,
				     <666 IRQ_TYPE_LEVEL_HIGH>, <667 IRQ_TYPE_LEVEL_HIGH>,
				     <668 IRQ_TYPE_LEVEL_HIGH>, <669 IRQ_TYPE_LEVEL_HIGH>,
				     <670 IRQ_TYPE_LEVEL_HIGH>, <671 IRQ_TYPE_LEVEL_HIGH>,
				     <672 IRQ_TYPE_LEVEL_HIGH>, <673 IRQ_TYPE_LEVEL_HIGH>,
				     <674 IRQ_TYPE_LEVEL_HIGH>, <675 IRQ_TYPE_LEVEL_HIGH>,
				     <676 IRQ_TYPE_LEVEL_HIGH>, <677 IRQ_TYPE_LEVEL_HIGH>,
				     <678 IRQ_TYPE_LEVEL_HIGH>, <679 IRQ_TYPE_LEVEL_HIGH>,
				     <680 IRQ_TYPE_LEVEL_HIGH>, <681 IRQ_TYPE_LEVEL_HIGH>,
				     <682 IRQ_TYPE_LEVEL_HIGH>, <683 IRQ_TYPE_LEVEL_HIGH>,
				     <684 IRQ_TYPE_LEVEL_HIGH>, <685 IRQ_TYPE_LEVEL_HIGH>,
				     <686 IRQ_TYPE_LEVEL_HIGH>, <687 IRQ_TYPE_LEVEL_HIGH>,
				     <688 IRQ_TYPE_LEVEL_HIGH>, <689 IRQ_TYPE_LEVEL_HIGH>,
				     <690 IRQ_TYPE_LEVEL_HIGH>, <691 IRQ_TYPE_LEVEL_HIGH>,
				     <692 IRQ_TYPE_LEVEL_HIGH>, <693 IRQ_TYPE_LEVEL_HIGH>,
				     <694 IRQ_TYPE_LEVEL_HIGH>, <695 IRQ_TYPE_LEVEL_HIGH>,
				     <696 IRQ_TYPE_LEVEL_HIGH>, <697 IRQ_TYPE_LEVEL_HIGH>,
				     <698 IRQ_TYPE_LEVEL_HIGH>, <699 IRQ_TYPE_LEVEL_HIGH>,
				     <700 IRQ_TYPE_LEVEL_HIGH>, <701 IRQ_TYPE_LEVEL_HIGH>,
				     <702 IRQ_TYPE_LEVEL_HIGH>, <703 IRQ_TYPE_LEVEL_HIGH>,
				     <704 IRQ_TYPE_LEVEL_HIGH>, <705 IRQ_TYPE_LEVEL_HIGH>,
				     <706 IRQ_TYPE_LEVEL_HIGH>, <707 IRQ_TYPE_LEVEL_HIGH>,
				     <708 IRQ_TYPE_LEVEL_HIGH>, <709 IRQ_TYPE_LEVEL_HIGH>,
				     <710 IRQ_TYPE_LEVEL_HIGH>, <711 IRQ_TYPE_LEVEL_HIGH>,
				     <712 IRQ_TYPE_LEVEL_HIGH>, <713 IRQ_TYPE_LEVEL_HIGH>,
				     <714 IRQ_TYPE_LEVEL_HIGH>, <715 IRQ_TYPE_LEVEL_HIGH>,
				     <716 IRQ_TYPE_LEVEL_HIGH>, <717 IRQ_TYPE_LEVEL_HIGH>,
				     <718 IRQ_TYPE_LEVEL_HIGH>, <719 IRQ_TYPE_LEVEL_HIGH>,
				     <720 IRQ_TYPE_LEVEL_HIGH>, <721 IRQ_TYPE_LEVEL_HIGH>,
				     <722 IRQ_TYPE_LEVEL_HIGH>, <723 IRQ_TYPE_LEVEL_HIGH>,
				     <724 IRQ_TYPE_LEVEL_HIGH>, <725 IRQ_TYPE_LEVEL_HIGH>,
				     <726 IRQ_TYPE_LEVEL_HIGH>, <727 IRQ_TYPE_LEVEL_HIGH>,
				     <728 IRQ_TYPE_LEVEL_HIGH>, <729 IRQ_TYPE_LEVEL_HIGH>,
				     <730 IRQ_TYPE_LEVEL_HIGH>, <731 IRQ_TYPE_LEVEL_HIGH>,
				     <732 IRQ_TYPE_LEVEL_HIGH>, <733 IRQ_TYPE_LEVEL_HIGH>,
				     <734 IRQ_TYPE_LEVEL_HIGH>, <735 IRQ_TYPE_LEVEL_HIGH>,
				     <736 IRQ_TYPE_LEVEL_HIGH>, <737 IRQ_TYPE_LEVEL_HIGH>,
				     <738 IRQ_TYPE_LEVEL_HIGH>, <739 IRQ_TYPE_LEVEL_HIGH>,
				     <740 IRQ_TYPE_LEVEL_HIGH>, <741 IRQ_TYPE_LEVEL_HIGH>,
				     <742 IRQ_TYPE_LEVEL_HIGH>, <743 IRQ_TYPE_LEVEL_HIGH>,
				     <744 IRQ_TYPE_LEVEL_HIGH>, <745 IRQ_TYPE_LEVEL_HIGH>,
				     <746 IRQ_TYPE_LEVEL_HIGH>, <747 IRQ_TYPE_LEVEL_HIGH>,
				     <748 IRQ_TYPE_LEVEL_HIGH>, <749 IRQ_TYPE_LEVEL_HIGH>,
				     <750 IRQ_TYPE_LEVEL_HIGH>, <751 IRQ_TYPE_LEVEL_HIGH>,
				     <752 IRQ_TYPE_LEVEL_HIGH>, <753 IRQ_TYPE_LEVEL_HIGH>,
				     <754 IRQ_TYPE_LEVEL_HIGH>, <755 IRQ_TYPE_LEVEL_HIGH>,
				     <756 IRQ_TYPE_LEVEL_HIGH>, <757 IRQ_TYPE_LEVEL_HIGH>,
				     <758 IRQ_TYPE_LEVEL_HIGH>, <759 IRQ_TYPE_LEVEL_HIGH>,
				     <760 IRQ_TYPE_LEVEL_HIGH>, <761 IRQ_TYPE_LEVEL_HIGH>,
				     <762 IRQ_TYPE_LEVEL_HIGH>, <763 IRQ_TYPE_LEVEL_HIGH>,
				     <764 IRQ_TYPE_LEVEL_HIGH>, <765 IRQ_TYPE_LEVEL_HIGH>,
				     <766 IRQ_TYPE_LEVEL_HIGH>, <767 IRQ_TYPE_LEVEL_HIGH>,
				     <768 IRQ_TYPE_LEVEL_HIGH>, <769 IRQ_TYPE_LEVEL_HIGH>,
				     <770 IRQ_TYPE_LEVEL_HIGH>, <771 IRQ_TYPE_LEVEL_HIGH>,
				     <772 IRQ_TYPE_LEVEL_HIGH>, <773 IRQ_TYPE_LEVEL_HIGH>,
				     <774 IRQ_TYPE_LEVEL_HIGH>, <775 IRQ_TYPE_LEVEL_HIGH>,
				     <776 IRQ_TYPE_LEVEL_HIGH>, <777 IRQ_TYPE_LEVEL_HIGH>,
				     <778 IRQ_TYPE_LEVEL_HIGH>, <779 IRQ_TYPE_LEVEL_HIGH>,
				     <780 IRQ_TYPE_LEVEL_HIGH>, <781 IRQ_TYPE_LEVEL_HIGH>,
				     <782 IRQ_TYPE_LEVEL_HIGH>, <783 IRQ_TYPE_LEVEL_HIGH>,
				     <784 IRQ_TYPE_LEVEL_HIGH>, <785 IRQ_TYPE_LEVEL_HIGH>,
				     <786 IRQ_TYPE_LEVEL_HIGH>, <787 IRQ_TYPE_LEVEL_HIGH>,
				     <788 IRQ_TYPE_LEVEL_HIGH>, <789 IRQ_TYPE_LEVEL_HIGH>,
				     <790 IRQ_TYPE_LEVEL_HIGH>, <791 IRQ_TYPE_LEVEL_HIGH>,
				     <792 IRQ_TYPE_LEVEL_HIGH>, <793 IRQ_TYPE_LEVEL_HIGH>,
				     <794 IRQ_TYPE_LEVEL_HIGH>, <795 IRQ_TYPE_LEVEL_HIGH>,
				     <796 IRQ_TYPE_LEVEL_HIGH>, <797 IRQ_TYPE_LEVEL_HIGH>,
				     <798 IRQ_TYPE_LEVEL_HIGH>, <799 IRQ_TYPE_LEVEL_HIGH>,
				     <800 IRQ_TYPE_LEVEL_HIGH>, <801 IRQ_TYPE_LEVEL_HIGH>,
				     <802 IRQ_TYPE_LEVEL_HIGH>, <803 IRQ_TYPE_LEVEL_HIGH>,
				     <804 IRQ_TYPE_LEVEL_HIGH>, <805 IRQ_TYPE_LEVEL_HIGH>,
				     <806 IRQ_TYPE_LEVEL_HIGH>, <807 IRQ_TYPE_LEVEL_HIGH>,
				     <808 IRQ_TYPE_LEVEL_HIGH>, <809 IRQ_TYPE_LEVEL_HIGH>,
				     <810 IRQ_TYPE_LEVEL_HIGH>, <811 IRQ_TYPE_LEVEL_HIGH>,
				     <812 IRQ_TYPE_LEVEL_HIGH>, <813 IRQ_TYPE_LEVEL_HIGH>,
				     <814 IRQ_TYPE_LEVEL_HIGH>, <815 IRQ_TYPE_LEVEL_HIGH>,
				     <816 IRQ_TYPE_LEVEL_HIGH>, <817 IRQ_TYPE_LEVEL_HIGH>,
				     <818 IRQ_TYPE_LEVEL_HIGH>, <819 IRQ_TYPE_LEVEL_HIGH>,
				     <820 IRQ_TYPE_LEVEL_HIGH>, <821 IRQ_TYPE_LEVEL_HIGH>,
				     <822 IRQ_TYPE_LEVEL_HIGH>, <823 IRQ_TYPE_LEVEL_HIGH>,
				     <824 IRQ_TYPE_LEVEL_HIGH>, <825 IRQ_TYPE_LEVEL_HIGH>,
				     <826 IRQ_TYPE_LEVEL_HIGH>, <827 IRQ_TYPE_LEVEL_HIGH>,
				     <828 IRQ_TYPE_LEVEL_HIGH>, <829 IRQ_TYPE_LEVEL_HIGH>,
				     <830 IRQ_TYPE_LEVEL_HIGH>, <831 IRQ_TYPE_LEVEL_HIGH>,
				     <832 IRQ_TYPE_LEVEL_HIGH>, <833 IRQ_TYPE_LEVEL_HIGH>,
				     <834 IRQ_TYPE_LEVEL_HIGH>, <835 IRQ_TYPE_LEVEL_HIGH>,
				     <836 IRQ_TYPE_LEVEL_HIGH>, <837 IRQ_TYPE_LEVEL_HIGH>,
				     <838 IRQ_TYPE_LEVEL_HIGH>, <839 IRQ_TYPE_LEVEL_HIGH>,
				     <840 IRQ_TYPE_LEVEL_HIGH>, <841 IRQ_TYPE_LEVEL_HIGH>,
				     <842 IRQ_TYPE_LEVEL_HIGH>, <843 IRQ_TYPE_LEVEL_HIGH>,
				     <844 IRQ_TYPE_LEVEL_HIGH>, <845 IRQ_TYPE_LEVEL_HIGH>,
				     <846 IRQ_TYPE_LEVEL_HIGH>, <847 IRQ_TYPE_LEVEL_HIGH>,
				     <848 IRQ_TYPE_LEVEL_HIGH>, <849 IRQ_TYPE_LEVEL_HIGH>,
				     <850 IRQ_TYPE_LEVEL_HIGH>, <851 IRQ_TYPE_LEVEL_HIGH>,
				     <852 IRQ_TYPE_LEVEL_HIGH>, <853 IRQ_TYPE_LEVEL_HIGH>,
				     <854 IRQ_TYPE_LEVEL_HIGH>, <855 IRQ_TYPE_LEVEL_HIGH>;
		};
	};
};
