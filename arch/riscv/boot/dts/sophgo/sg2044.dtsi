// SPDX-License-Identifier: (GPL-2.0 OR MIT)
/*
 * Copyright (C) 2022 Sophgo Technology Inc. All rights reserved.
 */
#include "sg2044-cpus.dtsi"

/ {
	model = "SOPHGO SG2044 RISC-V";
	compatible = "sophgo,sg2044";
	#address-cells = <2>;
	#size-cells = <2>;
	dma-noncoherent;

	memory@80000000 {
		device_type = "memory";
		reg = <0x00000000 0x80000000 0x00000010 0x00000000>;
	};

	pmu {
		compatible = "riscv,pmu";
		riscv,event-to-mhpmevent =
			<0x00003 0x00000000 0x00000010>,
			<0x00004 0x00000000 0x00000011>,
			<0x00005 0x00000000 0x00000007>,
			<0x00006 0x00000000 0x00000006>,
			<0x00008 0x00000000 0x00000027>,
			<0x00009 0x00000000 0x00000028>,
			<0x10000 0x00000000 0x0000000c>,
			<0x10001 0x00000000 0x0000000d>,
			<0x10002 0x00000000 0x0000000e>,
			<0x10003 0x00000000 0x0000000f>,
			<0x10008 0x00000000 0x00000001>,
			<0x10009 0x00000000 0x00000002>,
			<0x10010 0x00000000 0x00000010>,
			<0x10011 0x00000000 0x00000011>,
			<0x10012 0x00000000 0x00000012>,
			<0x10013 0x00000000 0x00000013>,
			<0x10019 0x00000000 0x00000004>,
			<0x10021 0x00000000 0x00000003>,
			<0x10030 0x00000000 0x0000001c>,
			<0x10031 0x00000000 0x0000001b>;
		riscv,event-to-mhpmcounters =
			<0x00003 0x00003 0xfffffff8>,
			<0x00004 0x00004 0xfffffff8>,
			<0x00005 0x00005 0xfffffff8>,
			<0x00006 0x00006 0xfffffff8>,
			<0x00007 0x00007 0xfffffff8>,
			<0x00008 0x00008 0xfffffff8>,
			<0x00009 0x00009 0xfffffff8>,
			<0x0000a 0x0000a 0xfffffff8>,
			<0x10000 0x10000 0xfffffff8>,
			<0x10001 0x10001 0xfffffff8>,
			<0x10002 0x10002 0xfffffff8>,
			<0x10003 0x10003 0xfffffff8>,
			<0x10008 0x10008 0xfffffff8>,
			<0x10009 0x10009 0xfffffff8>,
			<0x10010 0x10010 0xfffffff8>,
			<0x10011 0x10011 0xfffffff8>,
			<0x10012 0x10012 0xfffffff8>,
			<0x10013 0x10013 0xfffffff8>,
			<0x10019 0x10019 0xfffffff8>,
			<0x10021 0x10021 0xfffffff8>,
			<0x10030 0x10030 0xfffffff8>,
			<0x10031 0x10031 0xfffffff8>;
		riscv,raw-event-to-mhpmcounters =
			<0x00000000 0x00000001 0xffffffff 0xffffffff 0xfffffff8>,
			<0x00000000 0x00000002 0xffffffff 0xffffffff 0xfffffff8>,
			<0x00000000 0x00000003 0xffffffff 0xffffffff 0xfffffff8>,
			<0x00000000 0x00000004 0xffffffff 0xffffffff 0xfffffff8>,
			<0x00000000 0x00000005 0xffffffff 0xffffffff 0xfffffff8>,
			<0x00000000 0x00000006 0xffffffff 0xffffffff 0xfffffff8>,
			<0x00000000 0x00000007 0xffffffff 0xffffffff 0xfffffff8>,
			<0x00000000 0x00000008 0xffffffff 0xffffffff 0xfffffff8>,
			<0x00000000 0x00000009 0xffffffff 0xffffffff 0xfffffff8>,
			<0x00000000 0x0000000a 0xffffffff 0xffffffff 0xfffffff8>,
			<0x00000000 0x0000000b 0xffffffff 0xffffffff 0xfffffff8>,
			<0x00000000 0x0000000c 0xffffffff 0xffffffff 0xfffffff8>,
			<0x00000000 0x0000000d 0xffffffff 0xffffffff 0xfffffff8>,
			<0x00000000 0x0000000e 0xffffffff 0xffffffff 0xfffffff8>,
			<0x00000000 0x0000000f 0xffffffff 0xffffffff 0xfffffff8>,
			<0x00000000 0x00000010 0xffffffff 0xffffffff 0xfffffff8>,
			<0x00000000 0x00000011 0xffffffff 0xffffffff 0xfffffff8>,
			<0x00000000 0x00000012 0xffffffff 0xffffffff 0xfffffff8>,
			<0x00000000 0x00000013 0xffffffff 0xffffffff 0xfffffff8>,
			<0x00000000 0x00000014 0xffffffff 0xffffffff 0xfffffff8>,
			<0x00000000 0x00000015 0xffffffff 0xffffffff 0xfffffff8>,
			<0x00000000 0x00000016 0xffffffff 0xffffffff 0xfffffff8>,
			<0x00000000 0x00000017 0xffffffff 0xffffffff 0xfffffff8>,
			<0x00000000 0x00000018 0xffffffff 0xffffffff 0xfffffff8>,
			<0x00000000 0x00000019 0xffffffff 0xffffffff 0xfffffff8>,
			<0x00000000 0x0000001a 0xffffffff 0xffffffff 0xfffffff8>,
			<0x00000000 0x0000001b 0xffffffff 0xffffffff 0xfffffff8>,
			<0x00000000 0x0000001c 0xffffffff 0xffffffff 0xfffffff8>,
			<0x00000000 0x0000001d 0xffffffff 0xffffffff 0xfffffff8>,
			<0x00000000 0x0000001e 0xffffffff 0xffffffff 0xfffffff8>,
			<0x00000000 0x0000001f 0xffffffff 0xffffffff 0xfffffff8>,
			<0x00000000 0x00000020 0xffffffff 0xffffffff 0xfffffff8>,
			<0x00000000 0x00000021 0xffffffff 0xffffffff 0xfffffff8>,
			<0x00000000 0x00000022 0xffffffff 0xffffffff 0xfffffff8>,
			<0x00000000 0x00000023 0xffffffff 0xffffffff 0xfffffff8>,
			<0x00000000 0x00000024 0xffffffff 0xffffffff 0xfffffff8>,
			<0x00000000 0x00000025 0xffffffff 0xffffffff 0xfffffff8>,
			<0x00000000 0x00000026 0xffffffff 0xffffffff 0xfffffff8>,
			<0x00000000 0x00000027 0xffffffff 0xffffffff 0xfffffff8>,
			<0x00000000 0x00000028 0xffffffff 0xffffffff 0xfffffff8>,
			<0x00000000 0x00000029 0xffffffff 0xffffffff 0xfffffff8>,
			<0x00000000 0x0000002a 0xffffffff 0xffffffff 0xfffffff8>;
	};
};
