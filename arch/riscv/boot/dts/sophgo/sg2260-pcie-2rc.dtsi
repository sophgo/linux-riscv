#include <dt-bindings/interrupt-controller/irq.h>

#define SOC_PERIPHERAL_IRQ(nr)	(nr)

/ {
	pcie@6c00000000 {
		compatible = "sophgo,sg2260-pcie-host";
		device_type = "pci";
		#address-cells = <3>;
		#size-cells = <2>;

		bus-range = <0x00 0x3f>;
		linux,pci-domain = <0>;
		cdns,max-outbound-regions = <16>;
		cdns,no-bar-match-nbits = <48>;
		//vendor-id = /bits/ 16 <0x1E30>;
		//device-id = /bits/ 16 <0x2042>;
		pcie-id = /bits/ 16 <0x1>;
		link-id = /bits/ 16 <0x0>;
		//top-intc-used = <1>;
		//top-intc-id = <0>;
		//msix-supported = <1>;
		interrupt-parent = <&intc1>;
		reg = <0x6c 0x00000000  0x0 0x00001000>,
		      <0x6c 0x00300000  0x0 0x00004000>,
		      <0x40 0x00000000  0x0 0x00001000>;
		reg-names = "dbi", "atu", "config";

		// IO, check IO_SPACE_LIMIT
		// 32bit prefetchable memory
		// 32bit non-prefetchable memory
		// 64bit prefetchable memory
		// 64bit non-prefetchable memory
		ranges = <0x01000000 0x0  0x00000000  0x00 0x10000000  0x0 0x00400000>,
			 <0x42000000 0x0  0x20000000  0x00 0x20000000  0x0 0x20000000>,
			 <0x02000000 0x0  0x40000000  0x00 0x40000000  0x0 0x20000000>,
			 <0x43000000 0x42 0x00000000  0x42 0x00000000  0x2 0x00000000>,
			 <0x03000000 0x41 0x00000000  0x41 0x00000000  0x1 0x00000000>;
		dma-ranges = <0x03000000 0x0 0x0 0x0 0x0 0x1f 0x0>;

		status = "okay";
	};
#if 0
	pcie@f060000000 {
		compatible = "sophgo,cdns-pcie-host";
		device_type = "pci";
		#address-cells = <3>;
		#size-cells = <2>;

		bus-range = <0x80 0xff>;
		linux,pci-domain = <2>;
		cdns,max-outbound-regions = <16>;
		cdns,no-bar-match-nbits = <48>;
		vendor-id = /bits/ 16 <0x1E30>;
		device-id = /bits/ 16 <0x2042>;
		pcie-id = /bits/ 16 <0x0>;
		link-id = /bits/ 16 <0x0>;
		top-intc-used = <1>;
		top-intc-id = <1>;
		msix-supported = <0>;
		interrupt-parent = <&intc2>;
		//interrupts = <SOC_PERIPHERAL_IRQ(346) IRQ_TYPE_LEVEL_HIGH>;
		//interrupt-names = "msi";
		reg = <0xf0 0x60000000  0x0 0x02000000>,
		      <0xc0 0x00000000  0x0 0x00001000>;
		reg-names = "reg", "cfg";

		// IO, check IO_SPACE_LIMIT
		// 32bit prefetchable memory
		// 32bit non-prefetchable memory
		// 64bit prefetchable memory
		// 64bit non-prefetchable memory
		ranges = <0x01000000 0x0  0x00800000  0xc0 0x10800000  0x0 0x00800000>,
			 <0x42000000 0x0  0xc0000000  0xc0 0xc0000000  0x0 0x20000000>,
			 <0x02000000 0x0  0xe0000000  0xc0 0xe0000000  0x0 0x20000000>,
			 <0x43000000 0xc2 0x00000000  0xc2 0x00000000  0x2 0x00000000>,
			 <0x03000000 0xc1 0x00000000  0xc1 0x00000000  0x1 0x00000000>;
		dma-ranges = <0x03000000 0x0 0x0 0x0 0x0 0x1f 0x0>;

		status = "okay";
	};
#endif
};
