#include <dt-bindings/interrupt-controller/irq.h>

#define SOC_PERIPHERAL_IRQ(nr)	(nr)

/ {
	intc1: top_intc@6D50000000 {
		compatible = "sophgo,pcie-intc";
		reg = <0x0  0xFEE00060 0x0 0x8>,
		      <0x6E 0x10000000 0x0 0x256>;
		reg-names = "set", "clr";
		reg-bitwidth = <32>;
		top-intc-id = <1>;
		interrupt-controller;
		#interrupt-cells = <0x2>; // only applies to child node
		for-msi;

		interrupt-parent = <&intc>;
		interrupts = <SOC_PERIPHERAL_IRQ(352)>,
			     <SOC_PERIPHERAL_IRQ(353)>,
			     <SOC_PERIPHERAL_IRQ(354)>,
			     <SOC_PERIPHERAL_IRQ(355)>,
			     <SOC_PERIPHERAL_IRQ(356)>,
			     <SOC_PERIPHERAL_IRQ(357)>,
			     <SOC_PERIPHERAL_IRQ(358)>,
			     <SOC_PERIPHERAL_IRQ(359)>,
			     <SOC_PERIPHERAL_IRQ(360)>,
			     <SOC_PERIPHERAL_IRQ(361)>,
			     <SOC_PERIPHERAL_IRQ(362)>,
			     <SOC_PERIPHERAL_IRQ(363)>,
			     <SOC_PERIPHERAL_IRQ(364)>,
			     <SOC_PERIPHERAL_IRQ(365)>,
			     <SOC_PERIPHERAL_IRQ(366)>,
			     <SOC_PERIPHERAL_IRQ(367)>,
			     <SOC_PERIPHERAL_IRQ(368)>,
			     <SOC_PERIPHERAL_IRQ(369)>,
			     <SOC_PERIPHERAL_IRQ(370)>,
			     <SOC_PERIPHERAL_IRQ(371)>,
			     <SOC_PERIPHERAL_IRQ(372)>,
			     <SOC_PERIPHERAL_IRQ(373)>,
			     <SOC_PERIPHERAL_IRQ(374)>,
			     <SOC_PERIPHERAL_IRQ(375)>,
			     <SOC_PERIPHERAL_IRQ(376)>,
			     <SOC_PERIPHERAL_IRQ(377)>,
			     <SOC_PERIPHERAL_IRQ(378)>,
			     <SOC_PERIPHERAL_IRQ(379)>,
			     <SOC_PERIPHERAL_IRQ(380)>,
			     <SOC_PERIPHERAL_IRQ(381)>,
			     <SOC_PERIPHERAL_IRQ(382)>,
			     <SOC_PERIPHERAL_IRQ(383)>,
			     <SOC_PERIPHERAL_IRQ(384)>,
			     <SOC_PERIPHERAL_IRQ(385)>,
			     <SOC_PERIPHERAL_IRQ(386)>,
			     <SOC_PERIPHERAL_IRQ(387)>,
			     <SOC_PERIPHERAL_IRQ(388)>,
			     <SOC_PERIPHERAL_IRQ(389)>,
			     <SOC_PERIPHERAL_IRQ(390)>,
			     <SOC_PERIPHERAL_IRQ(391)>,
			     <SOC_PERIPHERAL_IRQ(392)>,
			     <SOC_PERIPHERAL_IRQ(393)>,
			     <SOC_PERIPHERAL_IRQ(394)>,
			     <SOC_PERIPHERAL_IRQ(395)>,
			     <SOC_PERIPHERAL_IRQ(396)>,
			     <SOC_PERIPHERAL_IRQ(397)>,
			     <SOC_PERIPHERAL_IRQ(398)>,
			     <SOC_PERIPHERAL_IRQ(399)>,
			     <SOC_PERIPHERAL_IRQ(400)>,
			     <SOC_PERIPHERAL_IRQ(401)>,
			     <SOC_PERIPHERAL_IRQ(402)>,
			     <SOC_PERIPHERAL_IRQ(403)>,
			     <SOC_PERIPHERAL_IRQ(404)>,
			     <SOC_PERIPHERAL_IRQ(405)>,
			     <SOC_PERIPHERAL_IRQ(406)>,
			     <SOC_PERIPHERAL_IRQ(407)>,
			     <SOC_PERIPHERAL_IRQ(408)>,
			     <SOC_PERIPHERAL_IRQ(409)>,
			     <SOC_PERIPHERAL_IRQ(410)>,
			     <SOC_PERIPHERAL_IRQ(411)>,
			     <SOC_PERIPHERAL_IRQ(412)>,
			     <SOC_PERIPHERAL_IRQ(413)>,
			     <SOC_PERIPHERAL_IRQ(414)>,
			     <SOC_PERIPHERAL_IRQ(415)>;
		interrupt-names = "msi0",  "msi1",  "msi2",  "msi3",
				  "msi4",  "msi5",  "msi6",  "msi7",
				  "msi8",  "msi9",  "msi10", "msi11",
				  "msi12", "msi13", "msi14", "msi15",
				  "msi16", "msi17", "msi18", "msi19",
				  "msi20", "msi21", "msi22", "msi23",
				  "msi24", "msi25", "msi26", "msi27",
				  "msi28", "msi29", "msi30", "msi31",
				  "msi32", "msi33", "msi34", "msi35",
				  "msi36", "msi37", "msi38", "msi39",
				  "msi40", "msi41", "msi42", "msi43",
				  "msi44", "msi45", "msi46", "msi47",
				  "msi48", "msi49", "msi50", "msi51",
				  "msi52", "msi53", "msi54", "msi55",
				  "msi56", "msi57", "msi58", "msi59",
				  "msi60", "msi61", "msi62", "msi63";

	};

};
